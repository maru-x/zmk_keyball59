&spi1 {
    status = "okay";
    pmw3360@0 {
        compatible = "pixart,pmw3360";
        reg = <0>;
        spi-max-frequency = <2000000>;
        irq-gpios = <&gpio1 10 GPIO_ACTIVE_LOW>;
        cs-gpios = <&gpio1 15 GPIO_ACTIVE_LOW>;
        label = "PMW3360";
    };
};