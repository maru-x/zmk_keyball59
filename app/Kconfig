## app/dts/bindings/behavior/mouse-click-back.yaml
```yaml
description: "Mouse Click Back behavior binding"
compatible: "behavior,mouse-click-back"
properties:
  timeout-ms:
    type: integer
    description: "レイヤー復帰までのタイムアウト (ms)"
  return-layer:
    type: integer
    description: "復帰先のレイヤー番号"
```

## boards/shields/keyball59/Kconfig.shield
```kconfig
config SHIELD_KEYBALL59_LEFT
    def_bool $(shields_list_contains,keyball59_left)

config SHIELD_KEYBALL59_RIGHT
    def_bool $(shields_list_contains,keyball59_right)
```

## config/app/app/dts/bindings/pixart,pmw3610.yml
```yaml
properties:
  irq-gpios:
    $ref: /include/dt-bindings/gpio/gpio.yaml#/definitions/gpio-controller
  cs-gpios:
    $ref: /include/dt-bindings/gpio/gpio.yaml#/definitions/gpio-controller

  # ここから追記 ↓↓
  automouse-layer:
    type: int
    required: false
    description: "Trackball 操作中に自動的にアクティブにするレイヤー番号"

  scroll-layers:
    type: int
    required: false
    description: "スクロールモード時に切り替えるレイヤー一覧"

  snipe-layers:
    type: int
    required: false
    description: "スナイプ（精密移動）モード時に切り替えるレイヤー一覧"
```

## config/west.yml
```yaml
manifest:
  remotes:
    - name: zmkfirmware
      url-base: https://github.com/zmkfirmware
    - name: mygithub
      url-base: https://github.com/maru-x
    - name: mctechnology17
      url-base: https://github.com/mctechnology17
  projects:
    - name: zmk
      remote: zmkfirmware
      revision: main
      import: app/west.yml
    - name: zmk-pat9126-driver
      remote: mygithub # 自分の GitHub またはローカルパス
      revision: main
      path: modules/zephyr/pat9126
    #    - name: zmk-pmw3360-driver
    #      remote: mygithub
    #      revision: main
    #      path: modules/zephyr/pmw3360
    - name: zmk-nice-oled
      remote: mctechnology17
      revision: main
    - name: zmk-mouse-click-back
      remote: mygithub # 自分の GitHub またはローカルパス
      path: modules/zephyr/click_back
      revision: main
    # - name: zmk-trans-to
    #   remote: mygithub # 自分の GitHub またはローカルパス
    #   path: modules/zephyr/trans_to
    #   revision: main
    - name: zmk-key-press-to-layer
      remote: mygithub # 自分の GitHub またはローカルパス
      path: modules/zephyr/key_press_to_layer
      revision: main
  self:
    path: config
```

## dts/bindings/input/pixart,pmw3360.yaml
```yaml
# Copyright (c) 2025 The ZMK Contributors
# SPDX-License-Identifier: MIT
description: |
  Sensor driver for the pixart PMW3360 optical mouse sensor

compatible: "pixart,pmw3360"

include: spi-device.yaml

properties:
  irq-gpios:
    type: phandle-array
  cpi:
    type: int
    default: 4000
    description: "CPI value (Range: 50 - 8200)"
  snipe_cpi:
    type: int
    default: 200
    description: "CPI value (Range: 50 - 8200)"
  rotate-90:
    type: boolean
    description: "The sensor is installed rotated 90 degrees. Rotation properties are mutually exclusive."
  rotate-180:
    type: boolean
    description: "The sensor is installed rotated 180 degrees. Rotation properties are mutually exclusive."
  rotate-270:
    type: boolean
    description: "The sensor is installed rotated 270 degrees. Rotation properties are mutually exclusive."
  angle-tune:
    type: int
    default: -3
    description: "Adjust the sensor angle in degrees (Range: -30 - 30)."
  lift-height-3mm:
    type: boolean
    description: "Configure the lift-off height to be 3mm rather than the default 2mm."
  polling-interval:
    type: int
    default: 1000
    description: "The time, in microseconds, to wait between sensor polls when operating without an irq configured."
  mouse-x-inverted:
    type: boolean
    description: "Invert the X-axis movement."
  mouse-y-inverted:
    type: boolean
    description: "Invert the Y-axis movement."
  mouse-wheel-x-inverted:
    type: boolean
    description: "Invert the X-axis movement of the mouse wheel."
  mouse-wheel-y-inverted:
    type: boolean
    description: "Invert the Y-axis movement of the mouse wheel."
  automouse-layer:
    type: int
    default: -1
    required: false
    description: Layer number to activate on mouse movement
  scroll-layer:
    type: int
    default: -1
    required: false
    description: Layer number to activate on scroll wheel movement
  snipe-layer:
    type: int
    default: -1
    required: false
    description: Layer number to activate on snipe button press
  scroll-ticks:
    type: int
    default: 200
    description: "Number of scroll wheel ticks to send per scroll wheel movement event."
```

## modules/click_back/dts/bindings/behavior/behavior-mouse-click-back.yaml
```yaml
description: "Mouse Click Back behavior binding"
compatible: "behavior,mouse-click-back"
binding-cells: 1
properties:
  timeout-ms:
    type: integer
    description: "レイヤー復帰までのタイムアウト (ms)"
  return-layer:
    type: integer
    description: "復帰先のレイヤー番号"
  cells:
    - name: "param1"
      type: integer
      description: "HID マウスボタン番号 (0:L,1:R,2:M…)"
```

## modules/click_back/dts/bindings/behavior/zmk,behavior-mouse-click-back.yaml
```yaml
description: "Mouse Click Back behavior binding"
compatible: "zmk,behavior-mouse-click-back"

# This behavior takes one argument when used in a keymap (e.g., &mcb LCLK)
binding-cells: 1 # このビヘイビアがキーマップで使用される際に取る引数の数

properties:
  label: # keymapの mcb ノードで使用されている label プロパティの定義
    type: string
    required: true
    description: "Human-readable name for the behavior instance."
  timeout-ms:
    type: int # 'integer' から 'int' に変更 (より一般的)
    required: true
    description: "レイヤー復帰までのタイムアウト (ms)"
  return-layer:
    type: int # 'integer' から 'int' に変更 (より一般的)
    required: true
    description: "復帰先のレイヤー番号"
  "#binding-cells": # keymapの mcb ノードで使用されている #binding-cells プロパティの定義
    type: int
    required: true
    const: 1 # このビヘイビア定義自体が1つのセルを持つことを示す
    description: "Number of cells for the binding argument this behavior definition itself takes."
```
